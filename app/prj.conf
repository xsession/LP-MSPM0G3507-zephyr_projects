## west.yml
```
manifest:
  version: 0.7
 
  defaults:
    remote: zephyrproject
  remotes:
    - name: zephyrproject
      url-base: https://github.com/zephyrproject-rtos
    - name: mcutools
      url-base: https://github.com/mcu-tools
  projects:
    - name: zephyr
      repo-path: zephyr
      revision: v3.6.0
      import:
        path-prefix: deps
      path: zephyr
    - name: mcuboot
      remote: mcutools
      repo-path: mcuboot
      revision: v1.7.2
      path: deps/mcuboot
 
  self:
    path: application
```

## prj.conf
```kconfig
# nothing here

CONFIG_ASSERT=y
CONFIG_LOG=y
CONFIG_LOG_MODE_MINIMAL=y
CONFIG_ZBUS=y
CONFIG_ZBUS_LOG_LEVEL_INF=y
```

## src/main.c
```c
/*
 * Copyright (c) 2012-2014 Wind River Systems, Inc.
 *
 * SPDX-License-Identifier: Apache-2.0
 */

#include <stdio.h>

int main(void)
{
	printf("Hello World! %s\n", CONFIG_BOARD);

	return 0;
}
```

## inc/project_info.h
```c
#ifdef __PROJECT_INFO_H
#define __PROJECT_INFO_H

#define PROJECT_NAME "Paper Dispenser"
#define PROJECT_VERSION "1.0.0"
#define PROJECT_DESCRIPTION "Paper Dispenser Application"

#endif // __PROJECT_INFO_H
```
